## zmk/heawood42/Kconfig.defconfig
```kconfig
if SHIELD_HEAWOOD42_LEFT

config ZMK_KEYBOARD_NAME
    default "Heawood42"

config ZMK_SPLIT_ROLE_CENTRAL
    default y

endif

if SHIELD_HEAWOOD42_LEFT || SHIELD_HEAWOOD42_RIGHT

config ZMK_SPLIT
    default y

endif
```

## zmk/heawood42/Kconfig.shield
```kconfig
#license info here

config SHIELD_HEAWOOD_LEFT
    def_bool $(shields_list_contains,heawood42_left)

config SHIELD_HEAWOOD_RIGHT
    def_bool $(shields_list_contains,heawood42_right)
```
